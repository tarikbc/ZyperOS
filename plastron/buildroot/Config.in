## plastron/buildroot/Config.in
```kconfig
config BR2_PLASTRON_DEVICE
	string "ZyperOS device"
	default "pixel2"
	help
	  The handheld this system is for, by ZyperOS's device id
	  ("pixel2", "brick"): its build as ZyperOS states it, in
	  config/device/<id>.mk (from src/device/<id>_build.c), which the
	  packages read for the device's Diatom port, splash, payload and
	  /etc/zyperos/system. QEMU's system is the Pixel 2's.

source "$BR2_EXTERNAL_PX2_PATH/package/splash/Config.in"
source "$BR2_EXTERNAL_PX2_PATH/package/mesa3d-px2/Config.in"
source "$BR2_EXTERNAL_PX2_PATH/package/powerkey/Config.in"
source "$BR2_EXTERNAL_PX2_PATH/package/jackswitch/Config.in"
source "$BR2_EXTERNAL_PX2_PATH/package/zyperos-eq/Config.in"
source "$BR2_EXTERNAL_PX2_PATH/package/zyperos/Config.in"
source "$BR2_EXTERNAL_PX2_PATH/package/diatom/Config.in"
source "$BR2_EXTERNAL_PX2_PATH/package/usbrole/Config.in"
source "$BR2_EXTERNAL_PX2_PATH/package/usbdrive/Config.in"
source "$BR2_EXTERNAL_PX2_PATH/package/gauge/Config.in"
source "$BR2_EXTERNAL_PX2_PATH/package/hwdog/Config.in"
source "$BR2_EXTERNAL_PX2_PATH/package/px2sim/Config.in"
source "$BR2_EXTERNAL_PX2_PATH/package/pvr-ge8300/Config.in"
source "$BR2_EXTERNAL_PX2_PATH/package/xr829-firmware/Config.in"
source "$BR2_EXTERNAL_PX2_PATH/package/brick-kmods/Config.in"
source "$BR2_EXTERNAL_PX2_PATH/package/brick-tools/Config.in"
source "$BR2_EXTERNAL_PX2_PATH/package/brick-rootswitch/Config.in"
```

## plastron/buildroot/package/hwdog/Config.in
```kconfig
config BR2_PACKAGE_HWDOG
	bool "hwdog"
	help
	  Pets the PX30's hardware watchdog (/dev/watchdog), which U-Boot
	  starts and the kernel pets until this opens it: from init's first
	  step on, every 10 s with a 60 s timeout, locked in RAM and at a
	  real-time priority, so a long copy to a slow card never makes it
	  late. A kernel that stops is reset. Stopped by a shutdown's TERM.
	  zytest=hang or zytest=stall on the kernel's line tests the chain.
```

## plastron/buildroot/package/libudev-zero/Config.in
```kconfig
config BR2_PACKAGE_LIBUDEV_ZERO
	bool "libudev-zero"
	depends on BR2_TOOLCHAIN_HAS_THREADS
	help
	  libudev.so.1 without udev: libudev-zero, a libudev that reads
	  /sys and /dev itself, with no udev daemon and no rules. For the
	  programs that load libudev.so.1 and only ask it what devices
	  there are: PortMaster's Westonpack runtime (its weston, the DRM
	  backend and libinput), which stopped at its start without it.

	  Only the library goes into the image: no header, no pkg-config
	  file, nothing in staging. So no package built here finds a
	  libudev and builds against it (SDL2 stays without udev), and
	  this is not a udev provider (BR2_PACKAGE_HAS_UDEV stays off).

	  https://github.com/illiliti/libudev-zero
```

## plastron/buildroot/package/splash/Config.in
```kconfig
config BR2_PACKAGE_SPLASH
	bool "splash"
	select BR2_PACKAGE_LIBDRM if BR2_PLASTRON_DEVICE != "brick" && BR2_PLASTRON_DEVICE != "smartpro"
	select BR2_PACKAGE_ZLIB if BR2_PLASTRON_DEVICE = "brick" || BR2_PLASTRON_DEVICE = "smartpro"
	help
	  ZyperOS's boot animation, from the moment the panel lights until
	  ZyperOS takes the display over - which it does as soon as it is
	  ready, never waiting for the animation. The kernel leaves the
	  panel dark (see board/px2/boot.cmd), so this is also the first
	  thing to light it.

	  On the TrimUI Brick (BR2_PLASTRON_DEVICE "brick") it is splash-fb, which draws
	  on the framebuffer instead, from the moment it exists.
```

## plastron/buildroot/package/usbdrive/Config.in
```kconfig
config BR2_PACKAGE_USBDRIVE
	bool "usbdrive"
	# The Pixel 2's page is DRM's; the Brick's is its framebuffer
	select BR2_PACKAGE_LIBDRM if !BR2_PACKAGE_PVR_GE8300
	help
	  The games partition as a USB drive (configfs f_mass_storage) for
	  ZyperOS's Computer Connected > USB Drive: the card unmounted first,
	  exported until the computer ejects it or the cable comes out, then
	  checked, mounted again and ZyperOS started again. Never exported
	  while mounted.
```
