/dts-v1/;
/plugin/;

/* An R36S panel, from rk3326-r36s-panel1-linux.dtb, by plastron/scripts/r36s-panel.py */
&internal_display {
	compatible = "rocknix,generic-dsi";
	panel_description =
		"G size=52,70 delays=20,150,20,120,20 format=rgb888 lanes=4 flags=0xe03",
		"M clock=29000 horizontal=640,80,20,80 vertical=480,20,4,12 default=1",
		"I seq=e0abba",
		"I seq=e1baab",
		"I seq=b1100147ff",
		"I seq=b20c0804505014",
		"I seq=b35612e0",
		"I seq=b4333004",
		"I seq=b6b0000010001000",
		"I seq=b80512294948",
		"I seq=b97f635245423439243e3d3c59464d3e3d3022007f635245423439243e3d3c59464d3e3d302200",
		"I seq=c03210123422222222900490040f0000c1",
		"I seq=c1129f8e89900490045440",
		"I seq=c2770908890811223344871800",
		"I seq=c3884a24241e1f120c0e10040624240202020202020202",
		"I seq=c4090b24241e1f130d0f11050724240202020202020202",
		"I seq=c64655",
		"I seq=c8120031423416",
		"I seq=ca1843",
		"I seq=cd0e64642c166b06b3",
		"I seq=d2e32b3808",
		"I seq=d40001000e04440810000000",
		"I seq=e68009ffffffffffff",
		"I seq=f012032000ff",
		"I seq=f303",
		"I seq=11 wait=c8",
		"I seq=29 wait=14";
};
