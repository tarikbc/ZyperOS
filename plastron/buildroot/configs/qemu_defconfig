## plastron/buildroot/package/gauge/Config.in
```kconfig
config BR2_PACKAGE_GAUGE
	bool "gauge"
	help
	  Shows the battery on the four lights on the side: a bar filling
	  while charging, a red flash when the battery is low, and the level
	  when asked (SIGUSR1). ZyperOS sends it more on the FIFO /run/gauge:
	  the volume or brightness while it changes, a climb when files or
	  covers finish, a sparkle for an achievement; and from usbdrive or
	  ZyperOS, a wave while files move to or from the card. ZyperOS's
	  MENU > Side Lights picks which parts show
	  (words in .userdata/pixel2/side-lights on the card, read again on
	  SIGHUP). Started by init, with respawn.
```

## plastron/buildroot/package/mesa3d-px2/Config.in
```kconfig
config BR2_PACKAGE_MESA3D_PX2
	bool "mesa3d-px2"
	depends on !BR2_PACKAGE_MESA3D
	depends on BR2_INSTALL_LIBSTDCPP
	depends on BR2_TOOLCHAIN_HAS_THREADS
	select BR2_PACKAGE_EXPAT
	select BR2_PACKAGE_LIBDRM
	select BR2_PACKAGE_ZLIB
	select BR2_PACKAGE_HAS_LIBEGL
	select BR2_PACKAGE_HAS_LIBGLES
	select BR2_PACKAGE_HAS_LIBGBM
	select BR2_PACKAGE_LIBGBM_HAS_FEATURE_FORMAT_MODIFIER_PLANE_COUNT
	select BR2_PACKAGE_LIBGBM_HAS_FEATURE_DMA_BUF
	help
	  Mesa with only what the Pixel 2 needs: the Panfrost driver for its
	  Mali-G31, GBM and EGL for drawing straight to the display, and
	  OpenGL ES, plus desktop OpenGL through EGL for PortMaster's ports
	  (and the GL headers SDL2's OpenGL support is built against). Buildroot's own mesa3d ties Panfrost to building LLVM
	  and clang for the device, because Mesa 25.1 and later precompile
	  some Panfrost GPU kernels at build time. 25.0 doesn't, so this
	  package pins it.

if BR2_PACKAGE_MESA3D_PX2

config BR2_PACKAGE_MESA3D_PX2_LLVMPIPE
	bool "llvmpipe, for a display with no GPU"
	depends on BR2_PACKAGE_LLVM_ARCH_SUPPORTS
	depends on BR2_TOOLCHAIN_GCC_AT_LEAST_7
	depends on BR2_HOST_GCC_AT_LEAST_7
	depends on BR2_USE_WCHAR
	depends on !BR2_STATIC_LIBS
	select BR2_PACKAGE_LLVM
	help
	  Mesa's software renderer as well, llvmpipe, and kms_swrast,
	  which shows what it draws on any KMS display through dumb
	  buffers. For QEMU's virt machine (configs/qemu_defconfig),
	  whose virtio-gpu has no 3D on a Mac: GBM and EGL fall back
	  to it there by themselves, the same GLES 3 the programs ask
	  Panfrost for, drawn by the CPU. llvmpipe rather than
	  softpipe, which needs no LLVM: ZyperOS's menus moved at 4
	  frames a second on softpipe, which runs every shader one
	  pixel at a time on one core (2026-11-05).

config BR2_PACKAGE_PROVIDES_LIBEGL
	default "mesa3d-px2"

config BR2_PACKAGE_PROVIDES_LIBGLES
	default "mesa3d-px2"

config BR2_PACKAGE_PROVIDES_LIBGBM
	default "mesa3d-px2"

endif
```

## plastron/buildroot/package/px2sim/Config.in
```kconfig
config BR2_PACKAGE_PX2SIM
	bool "px2sim"
	depends on BR2_LINUX_KERNEL
	help
	  The GKD Pixel 2's buttons and parts in QEMU's virt machine
	  (configs/qemu_defconfig): its joypad, volume keys, power key
	  and headphone jack made through uinput, its battery, charger,
	  backlight and side lights made by a kernel module (px2sim_hw),
	  all under the names the Pixel 2's kernel gives them, and the
	  link to ZyperOS's simulator window on the Mac over a
	  virtio-serial port. Run once by init, before ZyperOS.
```

## plastron/buildroot/package/usbdrive/Config.in
```kconfig
config BR2_PACKAGE_USBDRIVE
	bool "usbdrive"
	select BR2_PACKAGE_LIBDRM
	help
	  The games partition as a USB drive (configfs f_mass_storage) for
	  ZyperOS's Computer Connected > USB Drive: the card unmounted first,
	  exported until the computer ejects it or the cable comes out, then
	  checked, mounted again and ZyperOS started again. Never exported
	  while mounted.
```

## plastron/buildroot/package/zyperos/Config.in
```kconfig
config BR2_PACKAGE_ZYPEROS
	bool "zyperos"
	depends on BR2_PACKAGE_SDL2_IMAGE
	depends on BR2_PACKAGE_SDL2_TTF
	depends on BR2_PACKAGE_FFMPEG
	select BR2_PACKAGE_SQLITE
	select BR2_PACKAGE_ALSA_LIB
	select BR2_PACKAGE_ZLIB
	select BR2_PACKAGE_XZ # liblzma, for CHD discs (src/chd.c)
	select BR2_PACKAGE_LIBCURL
	select BR2_PACKAGE_OPENSSL
	help
	  The ZyperOS launcher (zyperos) and its music engine (muse),
	  built from the ZyperOS repository, mounted at /zyperos in the
	  build container.
```
